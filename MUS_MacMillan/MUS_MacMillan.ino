// VS1053b MIDI - MacMillan fractal map music //

#include <SPI.h>

#define MP3_XCS   6
#define MP3_XDCS  7
#define MP3_DREQ  2
#define MP3_RST   8

//VS10xx SCI Registers
#define SCI_MODE        0x00
#define SCI_STATUS      0x01
#define SCI_BASS        0x02
#define SCI_CLOCKF      0x03
#define SCI_DECODE_TIME 0x04
#define SCI_AUDATA      0x05
#define SCI_WRAM        0x06
#define SCI_WRAMADDR    0x07
#define SCI_HDAT0       0x08
#define SCI_HDAT1       0x09
#define SCI_AIADDR      0x0A
#define SCI_VOL         0x0B
#define SCI_AICTRL0     0x0C
#define SCI_AICTRL1     0x0D
#define SCI_AICTRL2     0x0E
#define SCI_AICTRL3     0x0F

#define BPM 120

  float x = 0.1f;
  float y = 0.1f;
  float m = 1.6f;
  float e = 0.5f;

void setup() {
  
  pinMode(MP3_RST, OUTPUT);
  pinMode(MP3_DREQ, INPUT);
  pinMode(MP3_XCS, OUTPUT);
  pinMode(MP3_XDCS, OUTPUT);
 
  SPI.begin();

  SPI.setClockDivider(SPI_CLOCK_DIV16); // SPI speed 1MHz (16MHz / 16 = 1MHz)
  SPI.transfer(0xFF);

  digitalWrite(MP3_RST, HIGH);
  digitalWrite(MP3_XCS, HIGH);
  digitalWrite(MP3_XDCS, HIGH);
  
  load_code();

  WriteRegister(SCI_CLOCKF, 0x8BE8);  // set multiplier to 3.5x
  WriteRegister(SCI_VOL, 0x3F3F);     // left, right volume 0xFE-0x0
  WriteRegister(SCI_BASS, 0x0000);    // bass, treble control
  
  SPI.setClockDivider(SPI_CLOCK_DIV4); // set SPI speed 4MHz (16MHz / 4 = 4MHz)

  uint8_t room = 0;   // reverb type
  uint8_t rval = 127; // reverb value

  reverb(0, room, rval);
  reverb(1, room, rval);
  reverb(2, room, rval);
  reverb(3, room, rval);
  reverb(4, room, rval);
  reverb(5, room, rval);
 
}

void loop() {

  float nx = x;
  float ny = y;
     
  x = ny;
  y = - nx + 2.0f * m * (ny /(1.0f + powf(ny,2.0f))) + e * ny;
            
  uint8_t xout = 64.0f + (13.6f * x);
  uint8_t yout = 64.0f + (13.6f * y);

  uint8_t poly = yout%6;
  uint8_t prog = xout;
  
  if (prog == 19) prog = 0;   // replace church organ to grand piano
  if (prog == 78) prog = 77;  // replace whistle to shakuhachi

  uint8_t vol = 32 + (yout/2);
  uint8_t note = 24 + (xout/2);
  uint8_t pan = 64.0f + (9.0f * x);

  note_on(poly, prog & 123, note & 127, vol & 127);
  
  uint8_t drum = map(yout, 0, 127, 27, 50); // note 35-81 drum kit

  note_on(9, prog & 123, drum & 127, vol & 127);

  int tempo = 60000 / BPM;
  delay(tempo / 4);
  
  uint8_t rel_off = yout%8;
  
  if (rel_off == 0) {all_sound_off(0); panning(0, pan & 127);}
  if (rel_off == 1) {all_sound_off(1); panning(1, pan & 127);}
  if (rel_off == 2) {all_sound_off(2); panning(2, pan & 127);}
  if (rel_off == 3) {all_sound_off(3); panning(3, pan & 127);}
  if (rel_off == 4) {all_sound_off(4); panning(4, pan & 127);}
  if (rel_off == 5) {all_sound_off(5); panning(5, pan & 127);}

  delay(tempo / 4);

}

void WriteRegister(char address, int data){
  
  while(!digitalRead(MP3_DREQ));
  digitalWrite(MP3_XCS, LOW);
  SPI.transfer(0x02);
  SPI.transfer(address);
  SPI.transfer((data >> 8) & 0xFF);
  SPI.transfer(data & 0xFF);
  while(!digitalRead(MP3_DREQ));
  digitalWrite(MP3_XCS, HIGH);

}

void note_on(byte chan, byte inst, byte note, byte vol){

  WriteRegister(SCI_MODE, 0x0c00);

  SPI.transfer(0xC0 | chan);
  SPI.transfer(0x00);
  SPI.transfer(inst);
  SPI.transfer(0x00);
  
  SPI.transfer(0x90 | chan);
  SPI.transfer(0x00);
  SPI.transfer(note);
  SPI.transfer(0x00);
  SPI.transfer(vol);
  SPI.transfer(0x00);

}

void note_off(byte chan, byte note){

  WriteRegister(SCI_MODE, 0x0c00);

  SPI.transfer(0x80 | chan);
  SPI.transfer(0x00);
  SPI.transfer(note);
  SPI.transfer(0x00);
  SPI.transfer(0x00);
  SPI.transfer(0x00);
  
}

void reverb(byte chan, byte typ, byte rev){
  
  WriteRegister(SCI_MODE, 0x0c00);

  SPI.transfer(0xB0 | chan);
  SPI.transfer(0x00);
  SPI.transfer(0x5B);
  SPI.transfer(0x00);
  SPI.transfer(rev);
  SPI.transfer(0x00);
  
  SPI.transfer(0xB0 | chan);
  SPI.transfer(0x00);
  SPI.transfer(0x0C);
  SPI.transfer(0x00);
  SPI.transfer(typ);
  SPI.transfer(0x00);

}

void panning(byte chan, byte pan){
  
  WriteRegister(SCI_MODE, 0x0c00);

  SPI.transfer(0xB0 | chan);
  SPI.transfer(0x00);
  SPI.transfer(0x0A);
  SPI.transfer(0x00);
  SPI.transfer(pan);
  SPI.transfer(0x00);

}

void all_sound_off(byte chan){
  
  WriteRegister(SCI_MODE, 0x0c00);

  SPI.transfer(0xB0 | chan);
  SPI.transfer(0x00);
  SPI.transfer(0x78);
  SPI.transfer(0x00);
  SPI.transfer(0xFF);
  SPI.transfer(0x00);

}

void pitch(byte chan, byte pitch){

  WriteRegister(SCI_MODE, 0x0c00);

  SPI.transfer(0xE0 | chan);
  SPI.transfer(0x00);
  SPI.transfer(pitch);
  SPI.transfer(0x00);

}

#define PLUGIN_SIZE 1039

const static word plugin[PLUGIN_SIZE] PROGMEM = { /* Compressed plugin */
  0x0007,0x0001, /*copy 1*/
  0x8050,
  0x0006,0x03f0, /*copy 1008*/
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  0x2a00,0x1a0e,0x000a,0x0001,0x0050,};

void load_code(void){
  
  int i = 0;
  while (i< PLUGIN_SIZE) {
    word addr, n, val;
    addr = pgm_read_word (&(plugin[i++]));
    n = pgm_read_word (&(plugin[i++]));
    if (n & 0x8000U) {
      n &= 0x7FFF;
      val = pgm_read_word (&(plugin[i++]));
      while (n--) {
        WriteRegister(addr , val);       
      }
    } 
    else {
      while (n--) {
        val = pgm_read_word (&(plugin[i++]));
        WriteRegister(addr , val);        
      }
    }
  }
  return;

}