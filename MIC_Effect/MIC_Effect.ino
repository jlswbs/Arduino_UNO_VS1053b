// VS1053b DSP hack - DSP modulation delay effect //

#include <SPI.h>

#define MP3_XCS   6
#define MP3_XDCS  7
#define MP3_DREQ  2
#define MP3_RST   8

//VS10xx SCI Registers
#define SCI_MODE        0x00
#define SCI_STATUS      0x01
#define SCI_BASS        0x02
#define SCI_CLOCKF      0x03
#define SCI_DECODE_TIME 0x04
#define SCI_AUDATA      0x05
#define SCI_WRAM        0x06
#define SCI_WRAMADDR    0x07
#define SCI_HDAT0       0x08
#define SCI_HDAT1       0x09
#define SCI_AIADDR      0x0A
#define SCI_VOL         0x0B
#define SCI_AICTRL0     0x0C
#define SCI_AICTRL1     0x0D
#define SCI_AICTRL2     0x0E
#define SCI_AICTRL3     0x0F

#define DEPTH 100    // [0..2047]  Depht effect 
#define SPEED 20     // [0..1023]  LFO oscillator    
#define DELAY 1000   // [0..8100]  Delay of effect channel in samples
#define DECAY 28000  // [0..32000] Speed of attenuation of the effect
#define MIX   24000  // [0..32000] Amount of delay/effect channel on output 


void setup() {
  
  pinMode(MP3_RST, OUTPUT);
  pinMode(MP3_DREQ, INPUT);
  pinMode(MP3_XCS, OUTPUT);
  pinMode(MP3_XDCS, OUTPUT);
 
  SPI.begin();

  SPI.setClockDivider(SPI_CLOCK_DIV16); // SPI speed 1MHz (16MHz / 16 = 1MHz)
  SPI.transfer(0xFF);

  digitalWrite(MP3_RST, HIGH);
  digitalWrite(MP3_XCS, HIGH);
  digitalWrite(MP3_XDCS, HIGH);
  
  load_code();

  WriteRegister(SCI_CLOCKF, 0x8BE8);    // set multiplier to 3.5x
  WriteRegister(SCI_VOL, 0x3F3F);       // left, right volume 0xFE-0x0
  WriteRegister(SCI_BASS, 0x0000);      // bass, treble control
  
  SPI.setClockDivider(SPI_CLOCK_DIV4);  // set SPI speed 4MHz (16MHz / 4 = 4MHz)

  WriteRegister(SCI_AUDATA, 0xAC44);    // set sample rate 44100 Hz 
  WriteRegister(SCI_AIADDR, 0x50);      // plugin enable

  WriteRegister(SCI_WRAMADDR, 0x0800);
  WriteRegister(SCI_WRAM, DEPTH);
  WriteRegister(SCI_WRAMADDR, 0x0801);
  WriteRegister(SCI_WRAM, SPEED);
  WriteRegister(SCI_WRAMADDR, 0x0802);
  WriteRegister(SCI_WRAM, DELAY);
  WriteRegister(SCI_WRAMADDR, 0x0803);
  WriteRegister(SCI_WRAM, DECAY);
  WriteRegister(SCI_WRAMADDR, 0x0804);
  WriteRegister(SCI_WRAM, MIX);

}

void loop() {


}

void WriteRegister(char address, int data){
  
  while(!digitalRead(MP3_DREQ));
  digitalWrite(MP3_XCS, LOW);
  SPI.transfer(0x02);
  SPI.transfer(address);
  SPI.transfer((data >> 8) & 0xFF);
  SPI.transfer(data & 0xFF);
  while(!digitalRead(MP3_DREQ));
  digitalWrite(MP3_XCS, HIGH);

}

int ReadRegister(char address){
  
  while(!digitalRead(MP3_DREQ));
  digitalWrite(MP3_XCS, LOW);
  SPI.transfer(0x03);
  SPI.transfer(address);
  char response1 = SPI.transfer(0xFF);
  while(!digitalRead(MP3_DREQ));
  char response2 = SPI.transfer(0xFF);
  while(!digitalRead(MP3_DREQ));
  digitalWrite(MP3_XCS, HIGH);
  int resultvalue = response1 << 8;
  resultvalue |= response2;
  return resultvalue;
  
}

#define PLUGIN_SIZE 771

const static word plugin[771] PROGMEM = { /* Compressed plugin */
  0x0007,0x0001, /*copy 1*/
  0x8050,
  0x0006,0x02ea, /*copy 746*/
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  0x2a00,0x584e, 
};

void load_code(void){
  
  int i = 0;
  while (i< PLUGIN_SIZE) {
    word addr, n, val;
    addr = pgm_read_word (&(plugin[i++]));
    n = pgm_read_word (&(plugin[i++]));
    if (n & 0x8000U) {
      n &= 0x7FFF;
      val = pgm_read_word (&(plugin[i++]));
      while (n--) {
        WriteRegister(addr , val);       
      }
    } 
    else {
      while (n--) {
        val = pgm_read_word (&(plugin[i++]));
        WriteRegister(addr , val);        
      }
    }
  }
  return;

}