// 3D Lorenz attractor music //

#include <SPI.h>
#include "Adafruit_VS1053.h"

#define SHIELD_RESET  8  // VS1053 reset pin (unused!)
#define SHIELD_CS     6  // VS1053 chip select pin (output)
#define SHIELD_DCS    7  // VS1053 Data/command select pin (output)
#define DREQ          2  // VS1053 Data request, ideally an Interrupt pinc
#define CARDCS        9  // Card chip select pin

Adafruit_VS1053_FilePlayer player = Adafruit_VS1053_FilePlayer(SHIELD_RESET, SHIELD_CS, SHIELD_DCS, DREQ, CARDCS);

#define MAXTEMPO 1   // 14 = 350 BPM 16th note
#define MINTEMPO 111 // 45 BPM 16th note
#define MAXADC  1023 // max ADC value
#define VOLUME 18    // Master volume

  float x = 0.5f;
  float y = 0.5f;
  float z = -1.0f;

  uint8_t delay_ms = 0;

void setup() {
  
  player.begin();
  
  load_code();

  player.sciWrite(VS1053_REG_VOLUME, 0x3F3F); // left, right volume 0xFE-0x0
  player.sciWrite(VS1053_REG_BASS, 0x0000);   // bass/treble control

  uint8_t room = 0;

  reverb(0, room, 96);
  reverb(1, room, 96);
  reverb(2, room, 96);
  reverb(3, room, 96);
  reverb(4, room, 96);
  reverb(5, room, 96);
 
}

void loop() {

  float oldx = x;
  float oldy = y;
  float oldz = z;
  
  x = oldx*oldy-oldz;
  y = oldx;
  z = oldy;
            
  uint8_t xout = 64.0f + (47.0f * x);
  uint8_t yout = 64.0f + (47.0f * y);
  uint8_t zout = 64.0f + (47.0f * z);

  uint8_t poly = yout%6;

  uint8_t prog = zout; 
  if (prog == 19) prog = 0; // replace church organ to grand piano
  if (prog == 78) prog = 77; // replace whistle to shakuhachi

  uint8_t vol = 32 + (yout/2);
  uint8_t note = 24 + (xout/2);
  uint8_t pan = 64.0f + (27.0f * z);

  note_on(poly, prog & 123, note & 127, vol & 127);
  
  uint8_t drum = map(zout, 0, 127, 27, 50); // note 35-81 drum kit

  note_on(9, prog & 123, drum & 127, vol & 127);

  delay_ms = MINTEMPO;

  delay (delay_ms);
  
  uint8_t rel_off = yout%8;
  
  if (rel_off == 0) {all_sound_off(0); panning(0, pan & 127);}
  if (rel_off == 1) {all_sound_off(1); panning(1, pan & 127);}
  if (rel_off == 2) {all_sound_off(2); panning(2, pan & 127);}
  if (rel_off == 3) {all_sound_off(3); panning(3, pan & 127);}
  if (rel_off == 4) {all_sound_off(4); panning(4, pan & 127);}
  if (rel_off == 5) {all_sound_off(5); panning(5, pan & 127);}

  delay (delay_ms);

}

void note_on(byte chan, byte inst, byte note, byte vol){

  player.sciWrite (VS1053_REG_MODE, 0x0c00);

  SPI.transfer(0xC0 | chan);
  SPI.transfer(0x00);
  SPI.transfer(inst);
  SPI.transfer(0x00);
  
  SPI.transfer(0x90 | chan);
  SPI.transfer(0x00);
  SPI.transfer(note);
  SPI.transfer(0x00);
  SPI.transfer(vol);
  SPI.transfer(0x00);

}

void note_off(byte chan, byte note){

  player.sciWrite (VS1053_REG_MODE, 0x0c00);

  SPI.transfer(0x80 | chan);
  SPI.transfer(0x00);
  SPI.transfer(note);
  SPI.transfer(0x00);
  SPI.transfer(0x00);
  SPI.transfer(0x00);
  
}

void reverb(byte chan, byte typ, byte rev){
  
  player.sciWrite (VS1053_REG_MODE, 0x0c00);

  SPI.transfer(0xB0 | chan);
  SPI.transfer(0x00);
  SPI.transfer(0x5B);
  SPI.transfer(0x00);
  SPI.transfer(rev);
  SPI.transfer(0x00);
  
  SPI.transfer(0xB0 | chan);
  SPI.transfer(0x00);
  SPI.transfer(0x0C);
  SPI.transfer(0x00);
  SPI.transfer(typ);
  SPI.transfer(0x00);

}

void panning(byte chan, byte pan){
  
  player.sciWrite (VS1053_REG_MODE, 0x0c00);

  SPI.transfer(0xB0 | chan);
  SPI.transfer(0x00);
  SPI.transfer(0x0A);
  SPI.transfer(0x00);
  SPI.transfer(pan);
  SPI.transfer(0x00);

}

void all_sound_off(byte chan){
  
  player.sciWrite (VS1053_REG_MODE, 0x0c00);

  SPI.transfer(0xB0 | chan);
  SPI.transfer(0x00);
  SPI.transfer(0x78);
  SPI.transfer(0x00);
  SPI.transfer(0xFF);
  SPI.transfer(0x00);

}

void pitch(byte chan, byte pitch){

  player.sciWrite (VS1053_REG_MODE, 0x0c00);

  SPI.transfer(0xE0 | chan);
  SPI.transfer(0x00);
  SPI.transfer(pitch);
  SPI.transfer(0x00);

}

const static word plugin[1039] PROGMEM = { /* Compressed plugin */
  0x0007,0x0001, /*copy 1*/
  0x8050,
  0x0006,0x03f0, /*copy 1008*/
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  0x2a00,0x1a0e,0x000a,0x0001,0x0050,};

#define PLUGIN_SIZE 1039

void load_code(void){
  
  int i = 0;
  while (i< PLUGIN_SIZE) {
    word addr, n, val;
    addr = pgm_read_word (&(plugin[i++]));
    n = pgm_read_word (&(plugin[i++]));
    if (n & 0x8000U) {
      n &= 0x7FFF;
      val = pgm_read_word (&(plugin[i++]));
      while (n--) {
        player.sciWrite (addr , val);       
      }
    } 
    else {
      while (n--) {
        val = pgm_read_word (&(plugin[i++]));
        player.sciWrite (addr , val);        
      }
    }
  }
  return;
}
